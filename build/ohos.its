## build/ohos.its
```
/*
 * U-Boot uImage source file for "Hi3516DV300"
 */

/dts-v1/;

/ {
    description = "U-Boot uImage source file for Hi3516DV300";
    #address-cells = <1>;

    images {
        kernel@1 {
            description = "Linux kernel for Hi3516DV300";
            data = /incbin/("./zImage-dtb");
            type = "kernel";
            arch = "arm";
            os = "linux";
            compression = "none";
            load = <0x82000000>;
            entry = <0x82000000>;
        };
	ramdisk@1 {
            description = "ohos Ramdisk Image";
            data = /incbin/("./ramdisk.img");
            type = "ramdisk";
            arch = "arm";
            os = "linux";
            compression = "none";
            load = <0x84000000>;
            entry = <0x84000000>;
        };
    };

    configurations {
        default = "conf@boot";
        conf@boot {
            description = "booting ARM Linux Kernel Image";
            kernel = "kernel@1";
            ramdisk = "ramdisk@1";
        };
    };
};
 
```
